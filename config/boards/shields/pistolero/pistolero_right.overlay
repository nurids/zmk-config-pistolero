#include "pistolero.dtsi"

&default_transform { // The matrix transform for this board is 6 columns over because the left half is 6 columns wide according to the matrix.
    col-offset = <6>;
};

&kscan0 {
	diode-direction = "col2row";
	col-gpios
		= <&xiao_d 9  GPIO_ACTIVE_HIGH>   //Col0
		, <&xiao_d 10 GPIO_ACTIVE_HIGH>   //Col1
		, <&xiao_d 8 GPIO_ACTIVE_HIGH>   //Col2
		, <&xiao_d 7 GPIO_ACTIVE_HIGH>   //Col3
		, <&gpio0 10 GPIO_ACTIVE_HIGH>   //Col4
		, <&gpio0 9  GPIO_ACTIVE_HIGH>   //Col5
		;
	row-gpios
		= <&gpio1 14  (GPIO_ACTIVE_HIGH | GPIO_PULL_DOWN)>    //Row0
		, <&xiao_d 2  (GPIO_ACTIVE_HIGH | GPIO_PULL_DOWN)>    //Row1
		, <&xiao_d 1   (GPIO_ACTIVE_HIGH | GPIO_PULL_DOWN)>    //Row2
		, <&xiao_d 3  (GPIO_ACTIVE_HIGH | GPIO_PULL_DOWN)>    //Row3
		;
};