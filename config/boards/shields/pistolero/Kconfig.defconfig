## config/boards/shields/pistolero/Kconfig.defconfig
```kconfig
if SHIELD_PISTOLERO_LEFT

config ZMK_KEYBOARD_NAME
	default "Pistolero L"

config ZMK_SPLIT_BLE_ROLE_CENTRAL
	default y

endif

if SHIELD_PISTOLERO_RIGHT

config ZMK_KEYBOARD_NAME
	default "Pistolero R"
	
endif

if SHIELD_PISTOLERO_LEFT || SHIELD_PISTOLERO_RIGHT

config ZMK_SPLIT
	default y

endif
```

## config/boards/shields/pistolero/Kconfig.shield
```kconfig
config SHIELD_PISTOLERO_LEFT
	def_bool $(shields_list_contains,pistolero_left)

config SHIELD_PISTOLERO_RIGHT
	def_bool $(shields_list_contains,pistolero_right)
```
